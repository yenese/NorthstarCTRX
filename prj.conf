## CMakeLists.txt
```
# SPDX-License-Identifier: Apache-2.0

cmake_minimum_required(VERSION 3.20.0)

find_package(Zephyr REQUIRED HINTS $ENV{ZEPHYR_BASE})
project(ctrx)

target_sources(app PRIVATE
    src/main.c
    src/my_spi.c
    src/nrf21540.c
    src/my_usb.c
    src/my_esb.c
    src/led.c
    src/systime.c
    src/rf52.c
    src/Northlib/ntrp.c
    src/Northlib/ntrprouter.c
)

target_include_directories(app PRIVATE
    ${CMAKE_CURRENT_SOURCE_DIR}/src
    ${CMAKE_CURRENT_SOURCE_DIR}/src/Northlib
)
```

## prj.conf
```kconfig
CONFIG_STDOUT_CONSOLE=y
CONFIG_USB_DEVICE_STACK=y
CONFIG_USB_DEVICE_PRODUCT="Zephyr CDC ACM sample"
CONFIG_USB_DEVICE_PID=0x0001
CONFIG_LOG=y
CONFIG_LOG_DEFAULT_LEVEL=3            
CONFIG_USB_DRIVER_LOG_LEVEL_ERR=y
CONFIG_USB_DEVICE_LOG_LEVEL_ERR=y
CONFIG_SERIAL=y
CONFIG_UART_INTERRUPT_DRIVEN=y
CONFIG_UART_LINE_CTRL=y
CONFIG_USB_DEVICE_INITIALIZE_AT_BOOT=n

CONFIG_PRINTK=y

CONFIG_CLOCK_CONTROL=y
CONFIG_CLOCK_CONTROL_NRF_K32SRC_SYNTH=y
CONFIG_CLOCK_CONTROL_NRF_K32SRC_XTAL=n
CONFIG_CLOCK_CONTROL_NRF_K32SRC_RC=n

CONFIG_NCS_SAMPLES_DEFAULTS=y
CONFIG_ESB=y
CONFIG_ESB_LOG_LEVEL_DBG=y

CONFIG_DK_LIBRARY=y
CONFIG_SPI=y
CONFIG_SPI_SLAVE=y
CONFIG_SPI_ASYNC=y
CONFIG_SPI_NRFX=y


CONFIG_MPSL=y
```

## src/main.c
```c
#include <zephyr/kernel.h>
#include <zephyr/logging/log.h>
#include <zephyr/drivers/clock_control.h>
#include <zephyr/drivers/clock_control/nrf_clock_control.h>

#include "my_usb.h"
#include "led.h"
#include "systime.h"
#include "Northlib/ntrprouter.h"

LOG_MODULE_REGISTER(esb_bridge, LOG_LEVEL_DBG);

#if defined(CONFIG_CLOCK_CONTROL_NRF)
int clocks_start(void)
{
    int err, res;
    struct onoff_manager *clk_mgr;
    struct onoff_client clk_cli;
    clk_mgr = z_nrf_clock_control_get_onoff(CLOCK_CONTROL_NRF_SUBSYS_HF);
    if (!clk_mgr) return -ENXIO;
    sys_notify_init_spinwait(&clk_cli.notify);
    err = onoff_request(clk_mgr, &clk_cli);
    if (err < 0) return err;
    do {
        err = sys_notify_fetch_result(&clk_cli.notify, &res);
        if (!err && res) return res;
    } while (err);
    return 0;
}
#else
BUILD_ASSERT(false, "No Clock Control driver");
#endif

int main(){
    ledInit();
    if (clocks_start() != 0) return -1;

    if (usbInit() != 0) {LOG_ERR("USB init failed.");  return 0;}
    LOG_INF("USB init complete!");
    
    NTRPR_Init();
    
    // Should never reach here as NTRPR_Init has infinite loop
    LOG_ERR("NTRPR_Init returned unexpectedly!");
    while(1) {
        k_msleep(1000);
    }
}
```

## src/led.c
```c
#include <zephyr/drivers/gpio.h>
#include <zephyr/kernel.h>
#include <zephyr/device.h>
#include <zephyr/devicetree.h>
#include <dk_buttons_and_leds.h>

#include "led.h"

#define LED0_NODE DT_ALIAS(led0)
#define LED1_NODE DT_ALIAS(led1)

// static const struct gpio_dt_spec led0 = GPIO_DT_SPEC_GET(LED0_NODE, gpios);
// static const struct gpio_dt_spec led1 = GPIO_DT_SPEC_GET(LED1_NODE, gpios);

static const struct gpio_dt_spec leds[2] = {
    GPIO_DT_SPEC_GET(LED0_NODE, gpios),
    GPIO_DT_SPEC_GET(LED1_NODE, gpios)
};

void ledInit(){
    if (!device_is_ready(leds[0].port)) return 0;

    gpio_pin_configure_dt(&leds[0], GPIO_OUTPUT_ACTIVE);
    gpio_pin_configure_dt(&leds[1], GPIO_OUTPUT_ACTIVE);
}

void ledWrite(uint8_t led, uint8_t val){
    gpio_pin_set_dt(&leds[led], (int)val);
}

void ledToggle(uint8_t led){
    gpio_pin_toggle_dt(&leds[led]);
}
```

## src/led.h
```c
#ifndef LED_H_
#define LED_H_

#include <stdint.h>

void ledInit(void);
void ledWrite(uint8_t led, uint8_t val);
void ledToggle(uint8_t led);

#endif
```

## src/my_esb.c
```c
#include <stdio.h>
#include <string.h>  
#include <stdint.h>
#include "my_esb.h"
#include "nrf21540.h"
#include "zephyr/drivers/gpio.h"
#include <zephyr/kernel.h>
#include <zephyr/device.h>
#include <zephyr/devicetree.h>
#include <zephyr/logging/log.h>
#include <esb.h>
#include <dk_buttons_and_leds.h>
#include <zephyr/drivers/clock_control.h>
#include <zephyr/drivers/clock_control/nrf_clock_control.h>

LOG_MODULE_REGISTER(my_esb, LOG_LEVEL_DBG);

// Global değişkenler
static bool esb_initialized = false;
static my_esb_config_t current_config;  // Burada tanımlı - static global değişken
static uint8_t base_addr_0[4] = {0xE7, 0xE7, 0xE7, 0xE7};
static uint8_t base_addr_1[4] = {0xC2, 0xC2, 0xC2, 0xC2};
static uint8_t addr_prefix[8] = {0xE7, 0xC2, 0xC3, 0xC4, 0xC5, 0xC6, 0xC7, 0xC8};


int my_esb_initialize(const my_esb_config_t *config)
{
    int err;
    
    // Eğer zaten başlatılmışsa önce deinit yap
    if (esb_initialized) {
        LOG_WRN("ESB already initialized, deinitializing first");
        my_esb_deinit();
    }
    
    // Konfigürasyonu sakla
    memcpy(&current_config, config, sizeof(my_esb_config_t));
    
    // ESB konfigürasyonunu hazırla
    struct esb_config esb_cfg;
    esb_cfg.protocol = ESB_PROTOCOL_ESB_DPL;
    esb_cfg.retransmit_delay = config->retransmit_delay;
    esb_cfg.retransmit_count = config->retransmit_count;
    esb_cfg.bitrate = (enum esb_bitrate)config->bitrate;  // Cast gerekli
    esb_cfg.crc = (enum esb_crc)config->crc_mode;         // Cast gerekli
    esb_cfg.event_handler = config->event_handler;
    esb_cfg.selective_auto_ack = config->selective_auto_ack;
    esb_cfg.tx_output_power = (enum esb_tx_power)config->tx_power;  // Cast gerekli
    
    if(config->mode == ESB_RX) {
        esb_cfg.mode = ESB_MODE_PRX;
    } else if(config->mode == ESB_TX) {
        esb_cfg.mode = ESB_MODE_PTX;
    }
    
    // ESB'yi başlat
    err = esb_init(&esb_cfg);
    if (err) {
        LOG_ERR("ESB init failed: %d", err);
        return err;
    }
    
    // Adres ayarları
    err = esb_set_base_address_0(base_addr_0);
    if (err) {
        LOG_ERR("Failed to set base address 0: %d", err);
        return err;
    }
    
    err = esb_set_base_address_1(base_addr_1);
    if (err) {
        LOG_ERR("Failed to set base address 1: %d", err);
        return err;
    }
    
    err = esb_set_prefixes(addr_prefix, ARRAY_SIZE(addr_prefix));
    if (err) {
        LOG_ERR("Failed to set prefixes: %d", err);
        return err;
    }
    
    // RF kanalını ayarla
    err = esb_set_rf_channel(config->rf_channel);
    if (err) {
        LOG_ERR("Failed to set RF channel: %d", err);
        return err;
    }
    
    esb_initialized = true;
    LOG_INF("ESB initialized - Mode: %s, Bitrate: %d, Channel: %d, TX Power: %d",
            config->mode == ESB_RX ? "RX" : "TX",
            config->bitrate,
            config->rf_channel,
            config->tx_power);
    
    return 0;
}

int my_esb_deinit(void)
{
    if (!esb_initialized) {
        LOG_WRN("ESB not initialized");
        return -EALREADY;
    }
    
    // ESB'yi durdur
    esb_stop_rx();
    
    // ESB'yi devre dışı bırak - esb_disable() void dönüyor
    esb_disable();
    
    esb_initialized = false;
    LOG_INF("ESB deinitialized");
    
    return 0;
}

int my_esb_transmit(const uint8_t *data, uint8_t len)
{
    if (!esb_initialized) {
        LOG_ERR("ESB not initialized");
        return -EINVAL;
    }
    
    while (!esb_is_idle()) {
        k_sleep(K_MSEC(1));
    }

    struct esb_payload payload = {0};
    payload.length = len;
    payload.pipe   = 0;
    payload.noack  = 1;
    memcpy(payload.data, data, len);

    int err = esb_write_payload(&payload);
    if (err) return err;
    
    err = esb_start_tx();
    return err;
}

int my_esb_receive(struct esb_payload *payload)
{
    if (!esb_initialized) {
        LOG_ERR("ESB not initialized");
        return -EINVAL;
    }
    
    while (!esb_is_idle()) {
        k_sleep(K_MSEC(1));
    }

    int err = esb_start_rx();
    if (err) return err;

    return esb_read_rx_payload(payload);
}

// Ayar fonksiyonları
int my_esb_set_bitrate(my_esb_bitrate_e bitrate)
{
    if (!esb_initialized) {
        LOG_ERR("ESB not initialized");
        return -EINVAL;
    }
    
    // Mevcut konfigürasyonu güncelle ve yeniden başlat
    current_config.bitrate = bitrate;
    return my_esb_initialize(&current_config);
}

int my_esb_set_tx_power(my_esb_tx_power_e tx_power)
{
    if (!esb_initialized) {
        LOG_ERR("ESB not initialized");
        return -EINVAL;
    }
    
    current_config.tx_power = tx_power;
    return my_esb_initialize(&current_config);
}

int my_esb_set_rf_channel(uint8_t channel)
{

    esb_stop_rx();

    if (!esb_initialized) {
        LOG_ERR("ESB not initialized");
        return -EINVAL;
    }
    
    if (channel > 100) {
        LOG_ERR("Invalid RF channel: %d", channel);
        return -EINVAL;
    }
    
    int err = esb_set_rf_channel(channel);
    if (err == 0) {
        current_config.rf_channel = channel;
        LOG_INF("RF channel set to: %d", channel);
    }

    esb_start_rx();
    
    return err;
}

int my_esb_set_retransmit_params(uint16_t delay, uint8_t count)
{
    if (!esb_initialized) {
        LOG_ERR("ESB not initialized");
        return -EINVAL;
    }
    
    current_config.retransmit_delay = delay;
    current_config.retransmit_count = count;
    return my_esb_initialize(&current_config);
}

int my_esb_set_crc_mode(my_esb_crc_e crc_mode)
{
    if (!esb_initialized) {
        LOG_ERR("ESB not initialized");
        return -EINVAL;
    }
    
    current_config.crc_mode = crc_mode;
    return my_esb_initialize(&current_config);
}

// Durum sorgulama fonksiyonları
int my_esb_get_rf_channel(uint8_t *channel)
{
    if (!esb_initialized) {
        LOG_ERR("ESB not initialized");
        return -EINVAL;
    }
    
    if (channel == NULL) {
        return -EINVAL;
    }
    
    *channel = current_config.rf_channel;
    return 0;
}

bool my_esb_is_initialized(void)
{
    return esb_initialized;
}

// Mevcut konfigürasyonu döndür
my_esb_config_t* my_esb_get_config(void)
{
    if (!esb_initialized) {
        return NULL;
    }
    
    return &current_config;
}

void my_esb_print_config(void)
{
    if (!esb_initialized) {
        LOG_ERR("ESB not initialized");
        return;
    }
    
    LOG_INF("=== ESB Configuration ===");
    LOG_INF("Mode: %s", current_config.mode == ESB_RX ? "RX" : "TX");
    
    const char *bitrate_str;
    switch(current_config.bitrate) {
        case MY_ESB_BITRATE_1MBPS:   bitrate_str = "1 Mbps"; break;
        case MY_ESB_BITRATE_2MBPS:   bitrate_str = "2 Mbps"; break;
        default: bitrate_str = "Unknown"; break;
    }
    LOG_INF("Bitrate: %s", bitrate_str);
    
    LOG_INF("TX Power: %d dBm", current_config.tx_power);
    LOG_INF("RF Channel: %d", current_config.rf_channel);
    LOG_INF("Retransmit Delay: %d us", current_config.retransmit_delay);
    LOG_INF("Retransmit Count: %d", current_config.retransmit_count);
    
    const char *crc_str;
    switch(current_config.crc_mode) {
        case MY_ESB_CRC_OFF:   crc_str = "OFF"; break;
        case MY_ESB_CRC_8BIT:  crc_str = "8-bit"; break;
        case MY_ESB_CRC_16BIT: crc_str = "16-bit"; break;
        default: crc_str = "Unknown"; break;
    }
    LOG_INF("CRC Mode: %s", crc_str);
    LOG_INF("Selective Auto ACK: %s", current_config.selective_auto_ack ? "Enabled" : "Disabled");
    LOG_INF("========================");
}
```

## src/my_esb.h
```c
#ifndef MY_ESB_H
#define MY_ESB_H

#include <stdint.h>
#include <esb.h>

typedef enum {
    ESB_TX,
    ESB_RX
} my_esb_mode_e;

typedef enum {
    MY_ESB_BITRATE_1MBPS   = ESB_BITRATE_1MBPS,
    MY_ESB_BITRATE_2MBPS   = ESB_BITRATE_2MBPS
} my_esb_bitrate_e;

typedef enum {
    MY_ESB_TX_POWER_NEG40DBM = ESB_TX_POWER_NEG40DBM,
    MY_ESB_TX_POWER_NEG20DBM = ESB_TX_POWER_NEG20DBM,
    MY_ESB_TX_POWER_NEG16DBM = ESB_TX_POWER_NEG16DBM,
    MY_ESB_TX_POWER_NEG12DBM = ESB_TX_POWER_NEG12DBM,
    MY_ESB_TX_POWER_NEG8DBM  = ESB_TX_POWER_NEG8DBM,
    MY_ESB_TX_POWER_NEG4DBM  = ESB_TX_POWER_NEG4DBM,
    MY_ESB_TX_POWER_0DBM     = ESB_TX_POWER_0DBM,
    MY_ESB_TX_POWER_4DBM     = ESB_TX_POWER_4DBM,
    MY_ESB_TX_POWER_8DBM     = ESB_TX_POWER_8DBM
} my_esb_tx_power_e;

typedef enum {
    MY_ESB_CRC_OFF   = ESB_CRC_OFF,
    MY_ESB_CRC_8BIT  = ESB_CRC_8BIT,
    MY_ESB_CRC_16BIT = ESB_CRC_16BIT
} my_esb_crc_e;

// ESB yapılandırma yapısı
typedef struct {
    my_esb_mode_e mode;
    my_esb_bitrate_e bitrate;
    my_esb_tx_power_e tx_power;
    uint16_t retransmit_delay;      // uint8_t yerine uint16_t
    uint8_t retransmit_count;
    uint8_t rf_channel;
    my_esb_crc_e crc_mode;
    bool selective_auto_ack;
    void (*event_handler)(const struct esb_evt *);
} my_esb_config_t;


// Fonksiyon prototipleri
int my_esb_initialize(const my_esb_config_t *config);
int my_esb_deinit(void);
int my_esb_transmit(const uint8_t *data, uint8_t len);
int my_esb_receive(struct esb_payload *payload);

// Ayar fonksiyonları
int my_esb_set_bitrate(my_esb_bitrate_e bitrate);
int my_esb_set_tx_power(my_esb_tx_power_e tx_power);
int my_esb_set_rf_channel(uint8_t channel);
int my_esb_set_retransmit_params(uint16_t delay, uint8_t count);  // uint16_t
int my_esb_set_crc_mode(my_esb_crc_e crc_mode);

// Durum sorgulama fonksiyonları
int my_esb_get_rf_channel(uint8_t *channel);
bool my_esb_is_initialized(void);
my_esb_config_t* my_esb_get_config(void);
void my_esb_print_config(void);

#endif
```

## src/my_spi.c
```c
#include <zephyr/drivers/spi.h>
#include <zephyr/drivers/gpio.h>
#include <string.h>
#include <stdint.h>
#include "my_spi.h"

struct spi_config spi_cfg = {
    .frequency = 8000000U,
    .operation = SPI_WORD_SET(8) | SPI_TRANSFER_MSB, // Mode 0 (CPOL=0, CPHA=0)
    .slave = 0,
    .cs = NULL // Manuel CS kontrolü
};

// 16-bit transfer: 1. byte komut/adres, 2. byte data/dummy
int nrf21540_spi_read_register(const struct device *spi_dev,
                               const struct device *gpio_dev,
                               uint8_t csn_pin,
                               uint8_t reg,
                               uint8_t *rx_value)
{
    uint8_t tx_buf[2] = { 0x80 | (reg & 0x3F), 0x00 }; // READ: b10xxxxxx
    uint8_t rx_buf[2] = { 0x00, 0x00 };

    struct spi_buf tx_bufs[] = { { .buf = tx_buf, .len = 2 } };
    struct spi_buf rx_bufs[] = { { .buf = rx_buf, .len = 2 } };

    struct spi_buf_set tx = { .buffers = tx_bufs, .count = 1 };
    struct spi_buf_set rx = { .buffers = rx_bufs, .count = 1 };

    gpio_pin_set(gpio_dev, csn_pin, 0);
    int err = spi_transceive(spi_dev, &spi_cfg , &tx, &rx);
    gpio_pin_set(gpio_dev, csn_pin, 1);

    if (err == 0 && rx_value) {
        *rx_value = rx_buf[1];
    }
    return err;
}

// nRF21540 register WRITE: b11xxxxxx + data
int nrf21540_spi_write_register(const struct device *spi_dev,
                                const struct device *gpio_dev,
                                uint8_t csn_pin,
                                uint8_t reg,
                                uint8_t data,
                                uint8_t *old_value)
{
    uint8_t tx_buf[2] = { 0xC0 | (reg & 0x3F), data }; // WRITE: b11xxxxxx
    uint8_t rx_buf[2] = { 0x00, 0x00 };

    struct spi_buf tx_bufs[] = { { .buf = tx_buf, .len = 2 } };
    struct spi_buf rx_bufs[] = { { .buf = rx_buf, .len = 2 } };

    struct spi_buf_set tx = { .buffers = tx_bufs, .count = 1 };
    struct spi_buf_set rx = { .buffers = rx_bufs, .count = 1 };

    gpio_pin_set(gpio_dev, csn_pin, 0);
    int err = spi_transceive(spi_dev, &spi_cfg, &tx, &rx);
    gpio_pin_set(gpio_dev, csn_pin, 1);

    // Önceki register değeri rx_buf[1]'de gelir (datasheet)
    if (err == 0 && old_value) {
        *old_value = rx_buf[1];
    }
    return err;
}
```

## src/my_spi.h
```c
#ifndef MY_SPI_H_
#define MY_SPI_H_

#include <stdint.h>
#include <zephyr/device.h>

int nrf21540_spi_read_register(const struct device *spi_dev,
                               const struct device *gpio_dev,
                               uint8_t csn_pin,
                               uint8_t reg,
                               uint8_t *rx_value);

int nrf21540_spi_write_register(const struct device *spi_dev,
                                const struct device *gpio_dev,
                                uint8_t csn_pin,
                                uint8_t reg,
                                uint8_t data,
                                 uint8_t *old_value); // Eski değeri döndürür (isteğe bağlı)



#endif 
```

## src/my_usb.c
```c
#include "my_usb.h"
#include <zephyr/usb/usb_device.h>
#include <zephyr/drivers/uart.h>
#include <zephyr/logging/log.h>
#include <zephyr/kernel.h>
#include <zephyr/sys/ring_buffer.h>
#include <zephyr/device.h>
#include <zephyr/devicetree.h>

#define RING_BUF_SIZE 1024  
#define FIFO_READ_CHUNK 128
#define USB_RX_TIMEOUT_MS 1000

static uint8_t ring_buffer[RING_BUF_SIZE];
static struct ring_buf usb_rx_ringbuf;
static volatile uint32_t usb_rx_overflow_count = 0;

static struct k_sem usb_rx_sem; /* SEMAPHORE */
static struct k_sem usb_tx_sem; 

const struct device *cdc_uart = DEVICE_DT_GET_ONE(zephyr_cdc_acm_uart);
 
int8_t usbInit(void){
    /* USB Start Listening */
    if (!cdc_uart || !device_is_ready(cdc_uart)) return -1;

    int ret = usb_enable(NULL);
    
    if (ret != 0) return -2;

    ring_buf_init(&usb_rx_ringbuf, sizeof(ring_buffer), ring_buffer);
    k_sem_init(&usb_rx_sem, 0, K_SEM_MAX_LIMIT);
    k_sem_init(&usb_tx_sem, 1, 1);  // TX available on start

    uart_irq_callback_set(cdc_uart, usbCallback);
    uart_irq_rx_enable(cdc_uart);

    return 0;
}

// Arduino Serial.available() + Serial.read() mantığı
int16_t usbRead(uint8_t* pRxData, uint16_t maxLen) {
    // Ring buffer'da veri var mı kontrol et (non-blocking)
    uint32_t available_bytes = ring_buf_size_get(&usb_rx_ringbuf);
    
    if (available_bytes == 0) {
        return 0; // Veri yok
    }
    
    // Maksimum okuma miktarını belirle
    uint16_t read_len = (available_bytes < maxLen) ? available_bytes : maxLen;
    
    // Veriyi oku
    uint32_t actual_read = ring_buf_get(&usb_rx_ringbuf, pRxData, read_len);
    
    return (int16_t)actual_read;
}

// Sadece mevcut veri miktarını döndür (Arduino Serial.available() gibi)
uint16_t usbAvailable(void) {
    return (uint16_t)ring_buf_size_get(&usb_rx_ringbuf);
}

// Tek byte oku (Arduino Serial.read() gibi)
int16_t usbReadByte(void) {
    uint8_t byte;
    if (ring_buf_get(&usb_rx_ringbuf, &byte, 1) == 1) {
        return byte;
    }
    return -1; // Veri yok
}

// Orijinal blocking receive fonksiyonu (eski davranış için)
int16_t usbReceive(uint8_t* pRxData, uint16_t len) {
    if (k_sem_take(&usb_rx_sem, K_MSEC(USB_RX_TIMEOUT_MS)) != 0) return -1; // Timeout

    uint32_t read_len = ring_buf_get(&usb_rx_ringbuf, pRxData, len); /* Read Data */
    
    if (!ring_buf_is_empty(&usb_rx_ringbuf)) { k_sem_give(&usb_rx_sem); /* Give semaphore again */ }

    return (int16_t)read_len;
}

int8_t usbTransmit(const uint8_t* pTxData, uint16_t len) {
    for (uint16_t i = 0; i < len; i++) { uart_poll_out(cdc_uart, pTxData[i]); }
    return 0;
}

void usbPrint(char* format, ...){

    va_list args;
    char temp[128] = {0};
    uint8_t length = 0;

    va_start(args, format);
    vsprintf(temp,format,args);
    va_end(args);

    for(uint8_t i = 0; i < 128; i++){
    	if(temp[i] == 0x00){
    		length = i;
    		break;
    	}
    }

    usbTransmit((uint8_t*)temp, length);
}

void usbCallback(const struct device *dev, void *user_data) {
    ARG_UNUSED(user_data);
    
    while (uart_irq_update(dev) && uart_irq_is_pending(dev)) {
        
        // RX interrupt
        if (uart_irq_rx_ready(dev)) {
            uint8_t buf[FIFO_READ_CHUNK];
            int recv_len = uart_fifo_read(dev, buf, sizeof(buf));
            
            if (recv_len > 0) {
                uint32_t stored_len = ring_buf_put(&usb_rx_ringbuf, buf, recv_len);
                
                if (stored_len < recv_len) {
                    usb_rx_overflow_count += (recv_len - stored_len);
                }
                
                k_sem_give(&usb_rx_sem);
            }
        }

        // TX interrupt
        if (uart_irq_tx_ready(dev)) {
            uart_irq_tx_disable(dev);  // TX interrupt'ı kapat
            k_sem_give(&usb_tx_sem);   // TX tamamlandı sinyali
        }
    }
}
```

## src/my_usb.h
```c
#ifndef MY_USB_H_
#define MY_USB_H_

#include <stdint.h>
#include <stdarg.h>
#include <zephyr/device.h>

#define USB_RX_TIMEOUT_MS   100
#define FIFO_READ_CHUNK     64

int8_t   usbInit(void);
uint16_t usbAvailable(void);
int16_t  usbRead(uint8_t* pRxData, uint16_t maxLen);
int16_t  usbReadByte(void);
int16_t  usbReceive(uint8_t* pRxData, uint16_t len);
int8_t   usbTransmit(const uint8_t* pTxData, uint16_t len);
void     usbCallback(const struct device *dev, void *user_data);
void     usbPrint(char* format, ...);

#endif 
```

## src/nrf21540.c
```c
#include "nrf21540.h"
#include "my_spi.h"
#include <zephyr/kernel.h>
#include <zephyr/device.h>
#include <zephyr/drivers/gpio.h>
#include <zephyr/logging/log.h>
#include <string.h>
#include <stdint.h>

LOG_MODULE_REGISTER(nrf21540, LOG_LEVEL_DBG);

#define REG_CONFREG0    0x00
#define REG_CONFREG1    0x01

nrf21540_status_t nrf21540_read_register(nrf21540_dev_t *dev, uint8_t reg, uint8_t *val) {
    int8_t status = nrf21540_spi_read_register(
        dev->hw.spi_dev, dev->hw.gpio_dev, dev->hw.csn_pin, reg, val
    );
    return (status == 0) ? NRF21540_OK : NRF21540_ERR;
}

nrf21540_status_t nrf21540_write_register(nrf21540_dev_t *dev, uint8_t reg, uint8_t val, uint8_t *old_val) {
    int8_t status = nrf21540_spi_write_register(
        dev->hw.spi_dev, dev->hw.gpio_dev, dev->hw.csn_pin, reg, val, old_val
    );
    return (status == 0) ? NRF21540_OK : NRF21540_ERR;
}

// INIT (sadece PDN pini GPIO, diğerleri SPI)
nrf21540_status_t nrf21540_init(nrf21540_dev_t *dev, nrf21540_hw_t *hw)
{
    memcpy(&dev->hw, hw, sizeof(nrf21540_hw_t));

    gpio_pin_configure(dev->hw.gpio_dev, dev->hw.pdn_pin, GPIO_OUTPUT_INACTIVE);
    gpio_pin_configure(dev->hw.gpio_dev, dev->hw.csn_pin, GPIO_OUTPUT_ACTIVE);

    gpio_pin_set(dev->hw.gpio_dev, dev->hw.pdn_pin, 0); // Power down
    k_busy_wait(NRF21540_T_TRX_TO_PD_US);
    gpio_pin_set(dev->hw.gpio_dev, dev->hw.pdn_pin, 1); // Power up
    k_busy_wait(NRF21540_T_PD_TO_PG_US);

    // Standby (TX/RX disable, gain=initial_gain)
    nrf21540_standby(dev);
    nrf21540_set_tx_gain(dev, hw->tx_gain);

    return NRF21540_OK;
}

nrf21540_status_t nrf21540_setup(nrf21540_dev_t *nrf21540_dev, nrf21540_hw_t *hw_config)
{

    if (!device_is_ready(hw_config->spi_dev) || !device_is_ready(hw_config->gpio_dev)) {
        LOG_ERR("SPI or GPIO not ready");
        return -ENODEV;
    }


    if (nrf21540_init(nrf21540_dev, hw_config) != NRF21540_OK) {
        LOG_ERR("nRF21540 init error!");
        return -EIO;
    }

    uint8_t part_number;
    if (nrf21540_read_register(nrf21540_dev, 0x14, &part_number) == NRF21540_OK)
        LOG_INF("nRF21540 Part Number: 0x%02X", part_number);
    else
        LOG_ERR("nRF21540 chip read fail");

    nrf21540_standby(nrf21540_dev);
    LOG_INF("nRF21540 setup complete, gain=%d, standby mode", hw_config->tx_gain);
    return NRF21540_OK;
}



nrf21540_status_t nrf21540_set_tx_gain(nrf21540_dev_t *dev, uint8_t gain)
{
    uint8_t confreg0 = ((gain & 0x1F) << 2);  // Sadece gain, TX ve MODE disable
    return nrf21540_write_register(dev, REG_CONFREG0, confreg0, NULL);
}

// TX mode: MODE=0, TX_EN=1, RX_EN=0, gain ayarla
nrf21540_status_t nrf21540_enable_tx(nrf21540_dev_t *dev)
{
    uint8_t confreg0 = (1 << 0)              // TX_EN = 1
                     | (0 << 1)              // MODE = 0 (POUTA)
                     | ((dev->hw.tx_gain & 0x1F) << 2); // GAIN
    nrf21540_write_register(dev, REG_CONFREG0, confreg0, NULL);
    nrf21540_write_register(dev, REG_CONFREG1, 0x00, NULL); // RX_EN=0
    k_busy_wait(NRF21540_T_PG_TO_TRX_US);
    return NRF21540_OK;
}

// RX mode: MODE=0, TX_EN=0, RX_EN=1
nrf21540_status_t nrf21540_enable_rx(nrf21540_dev_t *dev)
{
    uint8_t confreg0 = 0x00; // TX_EN=0, MODE=0, gain=0
    nrf21540_write_register(dev, REG_CONFREG0, confreg0, NULL);
    nrf21540_write_register(dev, REG_CONFREG1, 0x01, NULL); // RX_EN=1
    k_busy_wait(NRF21540_T_PG_TO_TRX_US);
    return NRF21540_OK;
}

// Standby (TX_EN=0, RX_EN=0, gain=0)
nrf21540_status_t nrf21540_standby(nrf21540_dev_t *dev)
{
    nrf21540_write_register(dev, REG_CONFREG0, 0x00, NULL);
    nrf21540_write_register(dev, REG_CONFREG1, 0x00, NULL);
    k_busy_wait(NRF21540_T_TRX_TO_PG_US);
    return NRF21540_OK;
}
```

## src/nrf21540.h
```c
#ifndef NRF21540_H
#define NRF21540_H

#include <stdint.h>
#include <zephyr/device.h>

// Status
typedef enum {
    NRF21540_OK = 0,
    NRF21540_ERR = -1
} nrf21540_status_t;

typedef struct {
    const struct device *spi_dev;
    const struct device *gpio_dev;
    uint8_t csn_pin;
    uint8_t pdn_pin;
    uint8_t tx_gain;
} nrf21540_hw_t;

typedef struct {
    nrf21540_hw_t hw;
} nrf21540_dev_t;


nrf21540_status_t nrf21540_read_register(nrf21540_dev_t *dev, uint8_t reg, uint8_t *val);
nrf21540_status_t nrf21540_write_register(nrf21540_dev_t *dev, uint8_t reg, uint8_t val, uint8_t *old_val);
nrf21540_status_t nrf21540_init(nrf21540_dev_t *dev, nrf21540_hw_t *hw);
nrf21540_status_t nrf21540_setup(nrf21540_dev_t *nrf21540_dev, nrf21540_hw_t *hw_config);
nrf21540_status_t nrf21540_set_tx_gain(nrf21540_dev_t *dev, uint8_t gain);
nrf21540_status_t nrf21540_enable_tx(nrf21540_dev_t *dev);
nrf21540_status_t nrf21540_enable_rx(nrf21540_dev_t *dev);
nrf21540_status_t nrf21540_standby(nrf21540_dev_t *dev);

// Timing (us)
#define NRF21540_T_TRX_TO_PD_US   5
#define NRF21540_T_PD_TO_PG_US    20
#define NRF21540_T_PG_TO_TRX_US   13
#define NRF21540_T_TRX_TO_PG_US   5

#endif
```

## src/rf52.c
```c
#include "rf52.h"
#include "nrf21540.h"
#include "my_esb.h"
#include <zephyr/drivers/gpio.h>
#include <zephyr/kernel.h>
#include <zephyr/device.h>
#include <zephyr/devicetree.h>
#include <esb.h>
#include <zephyr/drivers/clock_control.h>
#include <zephyr/drivers/clock_control/nrf_clock_control.h>

static struct esb_payload rx_payload;
static nrf21540_dev_t nrf21540_dev;
static volatile bool tx_done_flag = false;
static rf52RxCallback user_rx_callback = NULL;

void esbCallback(const struct esb_evt *event){
    switch (event->evt_id) {
        case ESB_EVENT_RX_RECEIVED:
            while (esb_read_rx_payload(&rx_payload) == 0) {
                if (user_rx_callback != NULL) {
                    user_rx_callback(rx_payload.data, rx_payload.length);
                }
            }
            break;
        case ESB_EVENT_TX_SUCCESS:
        case ESB_EVENT_TX_FAILED:
            tx_done_flag = true;
            break;
        default:
            break;
    }
}

int8_t rf52Init(rf52RxCallback rxCallback)
{
    user_rx_callback = rxCallback;
        
    /* NRF21540 Config */
    #define GPIO_NODE DT_NODELABEL(gpio0)
    const struct device *gpio_dev = DEVICE_DT_GET(GPIO_NODE);
    #define SPI_NODE DT_NODELABEL(spi1)
    const struct device *spi_dev = DEVICE_DT_GET(SPI_NODE);
    int err = 0;
    #define TX_GAIN_VALUE       31
    #define NRF21540_CSN_PIN    2
    #define NRF21540_PDN_PIN    8
    nrf21540_hw_t hw_config = {
        .spi_dev = spi_dev,
        .gpio_dev = gpio_dev,
        .csn_pin = NRF21540_CSN_PIN,
        .pdn_pin = NRF21540_PDN_PIN,
        .tx_gain = TX_GAIN_VALUE
    };

    /* ESB Config */
    my_esb_config_t esb_config;
    esb_config.mode = ESB_RX;
    esb_config.event_handler = esbCallback;
    esb_config.bitrate = MY_ESB_BITRATE_1MBPS;
    esb_config.tx_power = MY_ESB_TX_POWER_4DBM;
    esb_config.crc_mode = MY_ESB_CRC_16BIT;
    esb_config.selective_auto_ack = true;
    esb_config.rf_channel = 60;
    esb_config.retransmit_delay = 600;
    esb_config.retransmit_count = 3;

    if (nrf21540_setup(&nrf21540_dev, &hw_config) != 0) {
        return -1;
    }
    if (my_esb_initialize(&esb_config) != 0) {
        return -1;
    }
    
    my_esb_print_config();
    
    /* ESB Start Listening */
    nrf21540_enable_rx(&nrf21540_dev);
    esb_start_rx();
    return 0;
}

int8_t rf52Transmit(uint8_t* pTxBuffer, uint16_t len)
{
    esb_stop_rx();
    nrf21540_enable_tx(&nrf21540_dev);
    k_busy_wait(20);

    esb_flush_tx();
    my_esb_transmit(pTxBuffer, len);

    while (!tx_done_flag) {
        k_msleep(1);
    }
    tx_done_flag = false;

    nrf21540_enable_rx(&nrf21540_dev);
    esb_start_rx();
    
    return 0;
}

void rf52SetChannel(uint8_t ch){
    my_esb_set_rf_channel(ch);
}
```

## src/rf52.h
```c
#ifndef RF52_H_
#define RF52_H_

#include <stdint.h>

typedef void(*rf52RxCallback)(uint8_t *pRxData, uint16_t len);

int8_t rf52Init(rf52RxCallback rxCallback);
int8_t rf52Transmit(uint8_t* pTxBuffer, uint16_t len);
void   rf52SetChannel(uint8_t ch);

#endif
```
